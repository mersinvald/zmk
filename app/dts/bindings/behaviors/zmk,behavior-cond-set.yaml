## app/dts/bindings/behaviors/zmk,behavior-cond-set.yaml
```yaml
# Copyright (c) 2020 The ZMK Contributors
# SPDX-License-Identifier: MIT

description: Set Conditional State

compatible: "zmk,behavior-cond-set"

include: two_param.yaml
```

## app/dts/bindings/behaviors/zmk,behavior-cond.yaml
```yaml
description: Conditional Behavior

compatible: "zmk,behavior-cond"

properties:
  slot:
    type: int
    required: true
  bindings:
    type: phandle-array
    required: true

include: zero_param.yaml
```

## app/dts/bindings/behaviors/zmk,behavior-conditional-set.yaml
```yaml
# Copyright (c) 2020 The ZMK Contributors
# SPDX-License-Identifier: MIT

description: Set Conditional State

compatible: "zmk,behavior-conditional-set"

include: two_param.yaml
```

## app/dts/bindings/behaviors/zmk,behavior-conditional.yaml
```yaml
description: Conditional Behavior

compatible: "zmk,behavior-conditional"

properties:
  slot:
    type: int
    required: true
  bindings:
    type: phandle-array
    required: true

include: [zero_param.yaml]
```
